## package/asciidoc/Config.in.host
```kconfig
config BR2_PACKAGE_HOST_ASCIIDOC
	bool "host asciidoc"
	help
	  AsciiDoc.py documentation processor used for host-side package
	  documentation generation.

	  https://asciidoc-py.github.io/
```

## package/fastfetch/Config.in
```kconfig
config BR2_PACKAGE_FASTFETCH
	bool "fastfetch"
	depends on BR2_USE_MMU
	select BR2_PACKAGE_YYJSON
	help
	  A fast, feature-rich system information tool inspired by neofetch.

	  Fastfetch uses the Buildroot yyjson package instead of its embedded copy.

	  https://github.com/fastfetch-cli/fastfetch
```

## package/kuzpkg/Config.in
```kconfig
config BR2_PACKAGE_KUZPKG
	bool "kuzpkg"
	depends on BR2_USE_MMU
	depends on BR2_PACKAGE_BASH
	select BR2_PACKAGE_LIBARCHIVE
	select BR2_PACKAGE_LIBCURL
	select BR2_PACKAGE_GPGME
	select BR2_PACKAGE_OPENSSL
	select BR2_PACKAGE_ZSTD
	help
	  Pacman-style package manager and package builder for Kuznix.

	  Packages use the .kuzpkg.tar.zst format and PKGBUILD-compatible
	  build recipes. The upstream Kuznix-Team/kuzpkg git tree is used.

	  https://github.com/Kuznix-Team/kuzpkg

if BR2_PACKAGE_KUZPKG

config BR2_PACKAGE_KUZPKG_AUTO_PACKAGE
	bool "automatically create a .kuzpkg.tar.zst package"
	default y
	help
	  After the Buildroot target has been assembled, automatically create
	  a reproducible buildroot-system package from the selected configuration.
	  Package metadata is generated from make show-info and the bundled
	  PKGBUILD.proto template.

endif
```

## package/kuzpkg/Config.in.host
```kconfig
config BR2_PACKAGE_HOST_KUZPKG
	bool "host kuzpkg"
	select BR2_PACKAGE_HOST_MESON
	select BR2_PACKAGE_HOST_NINJA
	select BR2_PACKAGE_HOST_LIBARCHIVE
	select BR2_PACKAGE_HOST_FAKEROOT
	select BR2_PACKAGE_HOST_CURL
	select BR2_PACKAGE_HOST_GPGME
	select BR2_PACKAGE_HOST_ZSTD
	select BR2_PACKAGE_HOST_ASCIIDOC
	help
	  Host-side Kuznix package manager and PKGBUILD-compatible package
	  builder. This is used by Buildroot to generate .kuzpkg.tar.zst
	  packages from the configured target filesystem.
```

## package/yyjson/Config.in
```kconfig
config BR2_PACKAGE_YYJSON
	bool "yyjson"
	help
	  High-performance JSON library written in ANSI C.

	  https://github.com/ibireme/yyjson
```
